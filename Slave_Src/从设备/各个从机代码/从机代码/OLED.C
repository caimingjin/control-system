/***********************************
	文件名： OLED.C
	版本号： V1.0
	作  者： FG
	时  间： 2015-2-7 16:00:59
	备  注： 参考信意电子科技oled.c内容
*************************************/

#include "OLED.H"
#include "stc15.h"

sbit SCL_OLED   		= P1^3;
sbit SDA_OLED   		= P1^2;
sbit RST	    = P1^1;
sbit DC         = P1^0;

//操作汉字时，用户自行替换下面汉字及编码
const unsigned char code font16x16[] = {"模拟电视冰箱空调遥控℃"}; //这里只对汉字进行编码，请不要包含字符的编码
const unsigned char code font16x16_code[]={
	
0x10,0x10,0xD0,0xFF,0x90,0x14,0xE4,0xAF,0xA4,0xA4,0xA4,0xAF,0xE4,0x04,0x00,0x00,
0x04,0x03,0x00,0xFF,0x00,0x89,0x4B,0x2A,0x1A,0x0E,0x1A,0x2A,0x4B,0x88,0x80,0x00,   //模 →0
0x10,0x10,0x10,0xFF,0x90,0x00,0xF8,0x00,0x02,0x04,0x18,0x00,0xFF,0x00,0x00,0x00,
0x02,0x42,0x81,0x7F,0x00,0x00,0x3F,0x10,0x88,0x40,0x30,0x0C,0x0B,0x30,0xC0,0x00,  //拟 →1
/*--  文字:  电  --*/
/*--  宋体12;  此字体下对应的点阵为：宽x高=16x16   --*/
0x00,0x00,0xF8,0x88,0x88,0x88,0x88,0xFF,0x88,0x88,0x88,0x88,0xF8,0x00,0x00,0x00,
0x00,0x00,0x1F,0x08,0x08,0x08,0x08,0x7F,0x88,0x88,0x88,0x88,0x9F,0x80,0xF0,0x00,  //电  →0
	
/*--  文字:  视  --*/
/*--  宋体12;  此字体下对应的点阵为：宽x高=16x16   --*/
0x08,0x08,0x89,0xEE,0x98,0x00,0x00,0xFE,0x02,0x02,0xF2,0x02,0x02,0xFE,0x00,0x00,
0x02,0x01,0x00,0xFF,0x00,0x83,0x40,0x23,0x18,0x06,0x01,0x7E,0x80,0x83,0xE0,0x00,  //视  →1

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0x02,0x42,0x81,0x7F,0x00,0x40,0x40,0x42,0x42,0x42,0x7E,0x42,0x42,0x42,0x40,0x00,  //控  →1


/*--  文字:  ℃  --*/
/*--  宋体12;  此字体下对应的点阵为：宽x高=16x16   --*/
0x06,0x09,0x09,0xE6,0xF8,0x0C,0x04,0x02,0x02,0x02,0x02,0x02,0x04,0x1E,0x00,0x00,
0x00,0x00,0x00,0x07,0x1F,0x30,0x20,0x40,0x40,0x40,0x40,0x40,0x20,0x10,0x00,0x00,

};
//======================================================
void Delay_us()
{
	;
}

//======================================================
// 128X64OLED液晶底层驱动[6X8]字体库
// 设计者: 信意科技
// 描  述: [8X16]西文字符的字模数据 (纵向取模,字节倒序)
// !"#$%&'()*+,-./0123456789:;<=>?@ABCDEFGHIJKLMNOPQRSTUVWXYZ[\]^_`abcdefghijklmnopqrstuvwxyz{|}~
//备注：这里直接采用信意科技提供的8*16编码，用户也可采用编码工具自行编码
//======================================================
//
const unsigned char code F6x8[][6] ={0};
//{
//    { 0x00, 0x00, 0x00, 0x00, 0x00, 0x00 },   //sp0
//    { 0x00, 0x00, 0x00, 0x2f, 0x00, 0x00 },   // !1
//    { 0x00, 0x00, 0x07, 0x00, 0x07, 0x00 },   // "2
//    { 0x00, 0x14, 0x7f, 0x14, 0x7f, 0x14 },   // #3
//    { 0x00, 0x24, 0x2a, 0x7f, 0x2a, 0x12 },   // $4
//    { 0x00, 0x62, 0x64, 0x08, 0x13, 0x23 },   // %5
//    { 0x00, 0x36, 0x49, 0x55, 0x22, 0x50 },   // &6
//    { 0x00, 0x00, 0x05, 0x03, 0x00, 0x00 },   // '7
//    { 0x00, 0x00, 0x1c, 0x22, 0x41, 0x00 },   // (8
//    { 0x00, 0x00, 0x41, 0x22, 0x1c, 0x00 },   // )9
//    { 0x00, 0x14, 0x08, 0x3E, 0x08, 0x14 },   // *10
//    { 0x00, 0x08, 0x08, 0x3E, 0x08, 0x08 },   // +11
//    { 0x00, 0x00, 0x00, 0xA0, 0x60, 0x00 },   // ,12
//    { 0x00, 0x08, 0x08, 0x08, 0x08, 0x08 },   // -13
//    { 0x00, 0x00, 0x60, 0x60, 0x00, 0x00 },   // .14
//    { 0x00, 0x20, 0x10, 0x08, 0x04, 0x02 },   // /15
//    { 0x00, 0x3E, 0x51, 0x49, 0x45, 0x3E },   // 016
//    { 0x00, 0x00, 0x42, 0x7F, 0x40, 0x00 },   // 117
//    { 0x00, 0x42, 0x61, 0x51, 0x49, 0x46 },   // 218
//    { 0x00, 0x21, 0x41, 0x45, 0x4B, 0x31 },   // 319
//    { 0x00, 0x18, 0x14, 0x12, 0x7F, 0x10 },   // 420
//    { 0x00, 0x27, 0x45, 0x45, 0x45, 0x39 },   // 521
//    { 0x00, 0x3C, 0x4A, 0x49, 0x49, 0x30 },   // 622
//    { 0x00, 0x01, 0x71, 0x09, 0x05, 0x03 },   // 723
//    { 0x00, 0x36, 0x49, 0x49, 0x49, 0x36 },   // 824
//    { 0x00, 0x06, 0x49, 0x49, 0x29, 0x1E },   // 925
//    { 0x00, 0x00, 0x36, 0x36, 0x00, 0x00 },   // :26
//    { 0x00, 0x00, 0x56, 0x36, 0x00, 0x00 },   // ;27
//    { 0x00, 0x08, 0x14, 0x22, 0x41, 0x00 },   // <28
//    { 0x00, 0x14, 0x14, 0x14, 0x14, 0x14 },   // =29
//    { 0x00, 0x00, 0x41, 0x22, 0x14, 0x08 },   // >30
//    { 0x00, 0x02, 0x01, 0x51, 0x09, 0x06 },   // ?31
//    { 0x00, 0x32, 0x49, 0x59, 0x51, 0x3E },   // @32
//    { 0x00, 0x7C, 0x12, 0x11, 0x12, 0x7C },   // A33
//    { 0x00, 0x7F, 0x49, 0x49, 0x49, 0x36 },   // B34
//    { 0x00, 0x3E, 0x41, 0x41, 0x41, 0x22 },   // C35
//    { 0x00, 0x7F, 0x41, 0x41, 0x22, 0x1C },   // D36
//    { 0x00, 0x7F, 0x49, 0x49, 0x49, 0x41 },   // E37
//    { 0x00, 0x7F, 0x09, 0x09, 0x09, 0x01 },   // F38
//    { 0x00, 0x3E, 0x41, 0x49, 0x49, 0x7A },   // G39
//    { 0x00, 0x7F, 0x08, 0x08, 0x08, 0x7F },   // H40
//    { 0x00, 0x00, 0x41, 0x7F, 0x41, 0x00 },   // I41
//    { 0x00, 0x20, 0x40, 0x41, 0x3F, 0x01 },   // J42
//    { 0x00, 0x7F, 0x08, 0x14, 0x22, 0x41 },   // K43
//    { 0x00, 0x7F, 0x40, 0x40, 0x40, 0x40 },   // L44
//    { 0x00, 0x7F, 0x02, 0x0C, 0x02, 0x7F },   // M45
//    { 0x00, 0x7F, 0x04, 0x08, 0x10, 0x7F },   // N46
//    { 0x00, 0x3E, 0x41, 0x41, 0x41, 0x3E },   // O47
//    { 0x00, 0x7F, 0x09, 0x09, 0x09, 0x06 },   // P48
//    { 0x00, 0x3E, 0x41, 0x51, 0x21, 0x5E },   // Q49
//    { 0x00, 0x7F, 0x09, 0x19, 0x29, 0x46 },   // R50
//    { 0x00, 0x46, 0x49, 0x49, 0x49, 0x31 },   // S51
//    { 0x00, 0x01, 0x01, 0x7F, 0x01, 0x01 },   // T52
//    { 0x00, 0x3F, 0x40, 0x40, 0x40, 0x3F },   // U53
//    { 0x00, 0x1F, 0x20, 0x40, 0x20, 0x1F },   // V54
//    { 0x00, 0x3F, 0x40, 0x38, 0x40, 0x3F },   // W55
//    { 0x00, 0x63, 0x14, 0x08, 0x14, 0x63 },   // X56
//    { 0x00, 0x07, 0x08, 0x70, 0x08, 0x07 },   // Y57
//    { 0x00, 0x61, 0x51, 0x49, 0x45, 0x43 },   // Z58
//    { 0x00, 0x00, 0x7F, 0x41, 0x41, 0x00 },   // [59
//    { 0x00, 0x02, 0x04, 0x08, 0x10, 0x20 },   // \60
//    { 0x00, 0x00, 0x41, 0x41, 0x7F, 0x00 },   // ]61
//    { 0x00, 0x04, 0x02, 0x01, 0x02, 0x04 },   // ^62
//    { 0x00, 0x40, 0x40, 0x40, 0x40, 0x40 },   // _63
//    { 0x00, 0x00, 0x01, 0x02, 0x04, 0x00 },   // '64
//    { 0x00, 0x20, 0x54, 0x54, 0x54, 0x78 },   // a65
//    { 0x00, 0x7F, 0x48, 0x44, 0x44, 0x38 },   // b66
//    { 0x00, 0x38, 0x44, 0x44, 0x44, 0x20 },   // c67
//    { 0x00, 0x38, 0x44, 0x44, 0x48, 0x7F },   // d68
//    { 0x00, 0x38, 0x54, 0x54, 0x54, 0x18 },   // e69
//    { 0x00, 0x08, 0x7E, 0x09, 0x01, 0x02 },   // f70
//    { 0x00, 0x18, 0xA4, 0xA4, 0xA4, 0x7C },   // g71
//    { 0x00, 0x7F, 0x08, 0x04, 0x04, 0x78 },   // h72
//    { 0x00, 0x00, 0x44, 0x7D, 0x40, 0x00 },   // i73
//    { 0x00, 0x40, 0x80, 0x84, 0x7D, 0x00 },   // j74
//    { 0x00, 0x7F, 0x10, 0x28, 0x44, 0x00 },   // k75
//    { 0x00, 0x00, 0x41, 0x7F, 0x40, 0x00 },   // l76
//    { 0x00, 0x7C, 0x04, 0x18, 0x04, 0x78 },   // m77
//    { 0x00, 0x7C, 0x08, 0x04, 0x04, 0x78 },   // n78
//    { 0x00, 0x38, 0x44, 0x44, 0x44, 0x38 },   // o79
//    { 0x00, 0xFC, 0x24, 0x24, 0x24, 0x18 },   // p80
//    { 0x00, 0x18, 0x24, 0x24, 0x18, 0xFC },   // q81
//    { 0x00, 0x7C, 0x08, 0x04, 0x04, 0x08 },   // r82
//    { 0x00, 0x48, 0x54, 0x54, 0x54, 0x20 },   // s83
//    { 0x00, 0x04, 0x3F, 0x44, 0x40, 0x20 },   // t84
//    { 0x00, 0x3C, 0x40, 0x40, 0x20, 0x7C },   // u85
//    { 0x00, 0x1C, 0x20, 0x40, 0x20, 0x1C },   // v86
//    { 0x00, 0x3C, 0x40, 0x30, 0x40, 0x3C },   // w87
//    { 0x00, 0x44, 0x28, 0x10, 0x28, 0x44 },   // x88
//    { 0x00, 0x1C, 0xA0, 0xA0, 0xA0, 0x7C },   // y89
//    { 0x00, 0x44, 0x64, 0x54, 0x4C, 0x44 },   // z90
//    { 0x14, 0x14, 0x14, 0x14, 0x14, 0x14 }    // horiz lines91
//};

//======================================================
// 128X64OLED液晶底层驱动[8X16]字体库
// 设计者: 信意科技
// 描  述: [8X16]西文字符的字模数据 (纵向取模,字节倒序)
// !"#$%&'()*+,-./0123456789:;<=>?@ABCDEFGHIJKLMNOPQRSTUVWXYZ[\]^_`abcdefghijklmnopqrstuvwxyz{|}~
//备注：这里直接采用信意科技提供的8*16编码，用户也可采用编码工具自行编码
//======================================================

const unsigned char code F8X16[][16]=
{
    {0x00,0x00,0x00,0x00,0x00,0x00,0x00,0x00,0x00,0x00,0x00,0x00,0x00,0x00,0x00,0x00},// 0
    {0x00,0x00,0x00,0xF8,0x00,0x00,0x00,0x00,0x00,0x00,0x00,0x33,0x30,0x00,0x00,0x00},//!1
    {0x00,0x10,0x0C,0x06,0x10,0x0C,0x06,0x00,0x00,0x00,0x00,0x00,0x00,0x00,0x00,0x00},//"2
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    {0x00,0x06,0x01,0x01,0x02,0x02,0x04,0x04,0x00,0x00,0x00,0x00,0x00,0x00,0x00,0x00},//~94
};

/*----------------------------------------------------------------------------*
 * 内部函数原型                                                               *
 *----------------------------------------------------------------------------*/
void WriteDat(unsigned char Dat);
void WriteCmd(unsigned char Cmd);
void SetPos(unsigned char Page, unsigned char Column);
void FillScreen(unsigned char Dat);
void SetAddressMode(unsigned char  AddMode);	                 //取值为0~2
void SetStartPage(unsigned char StartPage);	                     //用于页地址模式
void SetStartColumn(unsigned char StartColumn);		             //用于页地址模式
void SetPageAddress(unsigned char Start, unsigned char End);	 //注：该函数仅用于水平地址或垂直地址模式
void SetColumnAddress(unsigned char Start, unsigned char End);   //注：该函数仅用于水平地址或垂直地址模式
void SetStartLine(unsigned char StartLine);	                     //取值：0~63
void SetContrast(unsigned char ContrastValue);	                 //取值范围为0~255共256级对比度
void SetChargePump(unsigned char  on);	                         //0：关闭电荷泵；1：开启电荷泵
void SetCommonRemap(unsigned char Dat);                          //设置COM输出的扫描方向
void SetSegmentRemap(unsigned char Dat);	                     //设置segment的重映射
void SetEntireDisplay(unsigned char OnMode);	                 // 0: 正常显示
void SetInverseDisplay(unsigned char InverseValue);	         // 反白显示开/关
void SetMultiplexRatio(unsigned char Ratio);	                 //取值：0~63
void SetDisplayOnOff(unsigned char on);	                         // 设置显示开/关
void SetDisplayOffset(unsigned char OffsetValue);
void SetDisplayClock(unsigned char Value);
void SetPrechargePeriod(unsigned char Value);                    // 设置预充电周期，缺省为0x22
void SetCommonConfig(unsigned char Dat);	                     // 缺省 => 0x12 (0x10)
void SetVCOMH(unsigned char Dat);                                //Dat格式： 0xxx_0000
void SetNop(void);
void OLED_Init(void);
void WriteChar_6x8(unsigned char Page,unsigned char Column, unsigned char Dat);
void WriteStr_8x16(unsigned char Page, unsigned char Column, unsigned char Str[]);
void WriteChinese16x16(unsigned char Page,unsigned char Column,unsigned char Str[]);
void WriteMixStrXx16(unsigned char Page, unsigned char Column, unsigned char Str[]);
void PrintChar(unsigned char Page, unsigned char Column, char Dat);
void PrintShort(unsigned char Page, unsigned char Column, int Dat);
void PrintImage(unsigned char ImageTable[], unsigned char RowNum, unsigned char ColumnNum);


/*----------------------------------------------------------------------------*
 * 外部函数原型                                                               *
 *----------------------------------------------------------------------------*/

/*****************************************************************************
 函 数 名  : WriteDat
 功能描述  : 向OLED写数据
 输入参数  : unsigned char   Dat
 输出参数  : NONE
 返 回 值  : NONE
*****************************************************************************/
void WriteDat(unsigned char Dat)
{
    unsigned char i;

    for(i=0;i<8;i++)
    {	
		DC   = 1;					  //写数据
    	SCL_OLED  = 0;					  //SCL_OLED拉低，为数据交换做准备
		Delay_us();

        if (Dat&0x80)			  	  //先发送最高位
            SDA_OLED = 1;
        else
            SDA_OLED = 0;

        SCL_OLED = 1; 					  //上升沿锁存数据到OLED
        Delay_us();   
        Dat <<= 1;    
    }
}

/*****************************************************************************
 函 数 名  : WriteCmd
 功能描述  : 向OLED写命令
 输入参数  : unsigned char Cmd  
 输出参数  : NONE
 返 回 值  : NONE
*****************************************************************************/
void WriteCmd(unsigned char Cmd)
{
       unsigned char i;

    for(i=0;i<8;i++)
    {	
		DC   = 0;					  //写命令
    	SCL_OLED  = 0;					  //SCL_OLED拉低，为数据交换做准备
		Delay_us();

        if (Cmd&0x80)			  	  //先发送最高位
            SDA_OLED = 1;
        else
            SDA_OLED = 0;

        SCL_OLED = 1; 					  //上升沿锁存数据到OLED
        Delay_us();   
        Cmd <<= 1;    
    }
}

/*****************************************************************************
 函 数 名  : SetPos
 功能描述  : 设置坐标
 输入参数  : unsigned char Page 
             unsigned char Column  
 输出参数  : NONE
 返 回 值  : NONE
*****************************************************************************/
void SetPos(unsigned char Page, unsigned char Column)	         //Column(列)取值0~127，Page(页)取值0~7
{ 
    WriteCmd(0xb0 + Page);					 //页模式下，设置页首地址，page的取值：0~7
    WriteCmd(((Column & 0xf0) >> 4) | 0x10);	 //列值对应的高四位命令： 0001_X7X6X5X4
    WriteCmd(( Column & 0x0f) | 0x00); 		 //列值对应的低四位命令： 0000_X3X2X1X0
} 

/*****************************************************************************
 函 数 名  : FillScreen
 功能描述  : 对全屏写入同一个字符 
             如 LED_Fill(0x01);    对于某一位0为不亮 1为亮
            ------------------------------------------------------
                                共128列
                  1           1                1   LSB
              共  0           0                0	↑
              8   0           0                0	|
   此         组  0       ……0     …………   0		    |
   为         字  0           0                0	|
   一         符  0           0                0	|
   页         即  0           0                0	|
              8   0           0                0	MSB
---------------------------------------------—-------------
              页  1           1                1
              64  0           0                0
              行  .           .                .
                  .           .    …………    .
                  .           .                . 
                  .           .                .
                  0           0                0
            ------------------------------------------------------
 输入参数  : unsigned char Dat  
 输出参数  : NONE
 返 回 值  : NONE
*****************************************************************************/
void FillScreen(unsigned char Dat)
{
    unsigned char Page,Column;
    
    for(Page = 0; Page < 8; Page++)
    {
        WriteCmd(0xb0 + Page);                  //0xb0+0~7表示页0~7，指定页的开始位置
        WriteCmd(0x00);                         //0x00+0~16表示将128列分成16组其地址在某组中的第几列
        WriteCmd(0x10);                         //0x10+0~16表示将128列分成16组其地址所在第几组
        for(Column = 0; Column < 128; Column++)	 //写128列
        {
            WriteDat(Dat);
        }
    }
} 

/*****************************************************************************
 函 数 名  : SetAddressMode
 功能描述  : 设置地址的模式
 输入参数  : unsigned char AddMode  
 输出参数  : NONE
 返 回 值  : NONE
*****************************************************************************/
void SetAddressMode(unsigned char  AddMode)	  //取值为0~2
{
    WriteCmd(0x20);        // 设置内存地址模式, 缺省 => 0x02，即：页地址模式
    WriteCmd(AddMode);      // 0x00 => 水平地址模式; 0x01 => 垂直地址模式; 0x02 => 页地址模式                                                       
}

/*****************************************************************************
 函 数 名  : SetStartPage
 功能描述  : 设置列的起始位置
 输入参数  : unsigned char StartPage  
 输出参数  : NONE
 返 回 值  : NONE
*****************************************************************************/
void SetStartPage(unsigned char StartPage)	//用于页地址模式	 
{
    WriteCmd(0xb0 | StartPage);		  		//StartPage取值：0~7
}

/*****************************************************************************
 函 数 名  : SetStartColumn
 功能描述  : 设置列的起始位置
 输入参数  : unsigned char StartColumn  
 输出参数  : NONE
 返 回 值  : NONE
*****************************************************************************/
void SetStartColumn(unsigned char StartColumn)		 //用于页地址模式
{													 //StartColumn取值0~127
    WriteCmd(((StartColumn & 0xf0) >> 4) | 0x10);	 //列值对应的高四位命令： 0001_X7X6X5X4
    WriteCmd(( StartColumn & 0x0f) | 0x00); 		 //列值对应的低四位命令： 0000_X3X2X1X0
}

/*****************************************************************************
 函 数 名  : SetPageAddress
 功能描述  : 设置行地址的作用范围
 输入参数  : unsigned char StartColumn  
 输出参数  : NONE
 返 回 值  : NONE
 备    注  : 该函数仅用于水平地址或垂直地址模式
*****************************************************************************/
void SetPageAddress(unsigned char Start, unsigned char End)	 //注：该函数仅用于水平地址或垂直地址模式
{
    WriteCmd(0x22);        // 设置页地址
    WriteCmd(Start);           // 起始页地址缺省值 => 0x00 
    WriteCmd(End);           // 结束页地址缺省值 => 0x07 
}

/*****************************************************************************
 函 数 名  : SetColumnAddress
 功能描述  : 设置列地址的作用范围
 输入参数  : unsigned char Start, unsigned char End  
 输出参数  : NONE
 返 回 值  : NONE
 备    注  : 该函数仅用于水平地址或垂直地址模式
*****************************************************************************/
void SetColumnAddress(unsigned char Start, unsigned char End) //注：该函数仅用于水平地址或垂直地址模式
{
    WriteCmd(0x21);        // 设置列地址
    WriteCmd(Start);       // 起始地址缺省值 => 0x00 
    WriteCmd(End);         // 结束地址缺省值 => 0x7F 
}

/*****************************************************************************
 函 数 名  : SetStartLine
 功能描述  : 设置起始的行值
 输入参数  : unsigned char StartLine  
 输出参数  : NONE
 返 回 值  : NONE
*****************************************************************************/
void SetStartLine(unsigned char StartLine)	  //取值：0~63
{
    WriteCmd(0x40|StartLine);                 // 设置显示的起始行, 缺省值 => 0x40 (0x00)                                             
}

/*****************************************************************************
 函 数 名  : SetContrast
 功能描述  : 设置起始的行值
 输入参数  : unsigned char ContrastValue  
 输出参数  : NONE
 返 回 值  : NONE
*****************************************************************************/
void SetContrast(unsigned char ContrastValue)	//取值范围为0~255共256级对比度
{
    WriteCmd(0x81);               // 设置OLED显示的对比度
    WriteCmd(ContrastValue);      // 缺省 => 0x7F
}

/*****************************************************************************
 函 数 名  : SetChargePump
 功能描述  : 设置起始的行值
 输入参数  : unsigned char On  
 输出参数  : NONE
 返 回 值  : NONE
*****************************************************************************/
void SetChargePump(unsigned char  on)	  //0：关闭电荷泵；1：开启电荷泵
{
    WriteCmd(0x8D);              		  // Set Charge Pump
	if(on)
    	WriteCmd(0x14);          		  // 0x14,使能电荷泵
	else
		WriteCmd(0x10);			          // 缺省 => 0x10，即关闭电荷泵
}

/*****************************************************************************
 函 数 名  : SetCommonRemap
 功能描述  : 设置行的重映射(可以通过com的重映射，实现垂直方向的镜像)
 输入参数  : unsigned char Dat  
 输出参数  : NONE
 返 回 值  : NONE
*****************************************************************************/
void SetCommonRemap(unsigned char Dat) //设置COM输出的扫描方向
{
	if(Dat)
    	WriteCmd(0xC8);   //0xc8 从COM63→0:
	else
		WriteCmd(0xC0);	  //缺省=> 0xC0，从COM0→63
}

/*****************************************************************************
 函 数 名  : SetSegmentRemap
 功能描述  : 设置列的重映射(可以通过Segment的重映射，实现水平方向的镜像)
 输入参数  : unsigned char On  
 输出参数  : NONE
 返 回 值  : NONE
*****************************************************************************/
void SetSegmentRemap(unsigned char Dat)	   // 设置segment的重映射
{										   // 缺省 => 0xA0
	if(Dat)
    	WriteCmd(0xA1); 				   // 0xA1 => 列127映射到SEG0
    else								   
		WriteCmd(0xA0);                    // 0xA0 => 列地址0映射到seg127   
}

/*****************************************************************************
 函 数 名  : SetEntireDisplay
 功能描述  : 设置整屏的显示内容 
 输入参数  : unsigned char On  
 输出参数  : NONE
 返 回 值  : NONE
*****************************************************************************/
void SetEntireDisplay(unsigned char OnMode)	  // 0: 正常显示
{
    if(OnMode)				// Set Entire Display On / Off
		WriteCmd(0xA5); 	// 0xA5 (0x01) => 开显示，但忽略RAM中内容
	else					 
		WriteCmd(0xA4);		// 0xA4 (缺省) => 正常显示，显示RAM中的内容                           
}

/*****************************************************************************
 函 数 名  : SetInverseDisplay
 功能描述  : 设置反白显示模式 
 输入参数  : unsigned char InverseValue  
 输出参数  : NONE
 返 回 值  : NONE
*****************************************************************************/
void  SetInverseDisplay(unsigned char InverseValue)	 // 反白显示开/关
{
    WriteCmd(0xA6|InverseValue); 	// 缺省(InverseValue = 0) => 0xA6，正常显示
                            		// 0xa7(InverseValue = 1) ,反白显示
}

/*****************************************************************************
 函 数 名  : SetMultiplexRatio
 功能描述  : 倍频率设置
 输入参数  : unsigned char Ratio  
 输出参数  : NONE
 返 回 值  : NONE
*****************************************************************************/
void SetMultiplexRatio(unsigned char Ratio)	//取值：0~63
{
    WriteCmd(0xA8);        // 设置倍频率
    WriteCmd(Ratio);       // 缺省 => 0x3F (1/64 Duty)
}

/*****************************************************************************
 函 数 名  : SetDisplayOnOff
 功能描述  : 显示开/关设置
 输入参数  : unsigned char ON  
 输出参数  : NONE
 返 回 值  : NONE
*****************************************************************************/
void SetDisplayOnOff(unsigned char on)	  // 设置显示开/关
{
    WriteCmd(0xAE|on); 	//0: 关显示；1：开显示 ，缺省为关
}

/*****************************************************************************
 函 数 名  : SetDisplayOffset
 功能描述  : 显示开/关设置
 输入参数  : unsigned char OffsetValue  
 输出参数  : NONE
 返 回 值  : NONE
*****************************************************************************/
void SetDisplayOffset(unsigned char OffsetValue)
{
    WriteCmd(0xD3);        // 设置显示偏移量
    WriteCmd(OffsetValue); // Default => 0x00 ，OffsetValue的取值0~63，可实现垂直方向上的偏移
}

/*****************************************************************************
 函 数 名  : SetDisplayClock
 功能描述  : 显示晶体频率及时钟分频率
 输入参数  : unsigned char Value  
 输出参数  : NONE
 返 回 值  : NONE
*****************************************************************************/
void SetDisplayClock(unsigned char Value)
{
    WriteCmd(0xD5);         // Set Display Clock Divide Ratio / Oscillator Frequency
    WriteCmd(Value);        // Default => 0x80
                            // D[3:0] => 数据低四位为分频率
                            // D[7:4] => 高四位为晶体频率
}

/*****************************************************************************
 函 数 名  : SetPrechargePeriod
 功能描述  : 设置预充电周期
 输入参数  : unsigned char Value  
 输出参数  : NONE
 返 回 值  : NONE
*****************************************************************************/
void SetPrechargePeriod(unsigned char Value) // 设置预充电周期，缺省为0x22
{						   
    WriteCmd(0xD9);        
    WriteCmd(Value);  // D[3:0]: 预充电周期，D[7:4]：放电周期 
}

/*****************************************************************************
 函 数 名  : SetCommonConfig
 功能描述  : 设置预充电周期
 输入参数  : unsigned char Dat  
 输出参数  : NONE
 返 回 值  : NONE
*****************************************************************************/
void SetCommonConfig(unsigned char Dat)	// 缺省 => 0x12 (0x10)
{
    WriteCmd(0xDA);        // 设置COM端的硬件配置
    WriteCmd(0x02|Dat);    // Alternative COM Pin Configuration
                           // Disable COM Left/Right Re-Map（Dat[5]:0,关闭COM重映射；1：使能COM重映射）
}

/*****************************************************************************
 函 数 名  : SetVCOMH
 功能描述  : 设置COM端的电平等级
 输入参数  : unsigned char Dat  
 输出参数  : NONE
 返 回 值  : NONE
*****************************************************************************/
void SetVCOMH(unsigned char Dat)   //Dat格式： 0xxx_0000
{
    WriteCmd(0xDB);        		   // Set VCOMH Deselect Level
    WriteCmd(Dat);                 // 缺省 => 0x20 (0.77*VCC)
}

/*****************************************************************************
 函 数 名  : SetNop
 功能描述  : 空操作 NOP
 输入参数  : NONE
 输出参数  : NONE
 返 回 值  : NONE
*****************************************************************************/
void SetNop(void)
{
    WriteCmd(0xE3);                // 不操作
}

/*****************************************************************************
 函 数 名  : LED_Init
 功能描述  : OLED初始化
 输入参数  : VOID  
 输出参数  : NONE
 返 回 值  : NONE
 备    注  ：详细请参考0.96inch_LDR128064B2B201 9.5 Recommanded Software Initialization
*****************************************************************************/
void OLED_Init(void)        
{
    unsigned char i;

    SCL_OLED = 1;      
    RST = 0;
    for(i = 0; i < 100; i++)
	{
		;                      //从上电到下面开始初始化要有足够的时间，即等待RC复位完毕    
    }      
    RST = 1;

    SetDisplayOnOff(0);        // 关显示 (0：关显示/1：开显示)
    SetDisplayClock(0x80);     // 设置时钟为100Frames/Sec ，0x80为缺省值
    SetMultiplexRatio(0x3F);   // 1/64 Duty (0x0F~0x3F)
    SetDisplayOffset(0x00);    // 垂直显示无偏移 (0x00~0x3F)
    SetStartLine(0x00);        // 设置映射内容显示的起始行(0x00~0x3F)
    SetChargePump(1);          // 使能内部DC/DC转换(0x00/0x04)
    SetAddressMode(0x02);      // 设置为页地址模式 (0x00/0x01/0x02)
    SetSegmentRemap(0x01);     // Segment重映射；  0x00左右反置 0x01正常
    SetCommonRemap(0x01);      // 设置COM扫描方向  0x00上下反置 0x08正常
    SetCommonConfig(0x10);     // 设置com序列的配置 (0x00/0x10)
    SetContrast(0x7F);         // 设置对比度
    SetPrechargePeriod(0xF1);  // 设置预充电周期为15个时钟，放电周期为1个时钟周期
    SetVCOMH(0x40);            // 设置COM端电平等级
    SetEntireDisplay(0);       // 正常显示(0：正常显示/1：忽略显示)
    SetInverseDisplay(0);      // 反白设置 (0：正常显示/1：反白显示)  
    SetDisplayOnOff(1);        // 开显示 (0：关显示/1：开显示)
    FillScreen(0x00);            // 初始清屏，填充空白
///    SetPos(0,0);		   //并将位置设置在0页，0列

} 
 
/*****************************************************************************
 函 数 名  : WriteChar_6x8
 功能描述  : 显示一个6x8标准ASCII字符
 输入参数  : unsigned char Column  显示的横坐标0~122,
                                   因为6*8格式的字符宽度为6，因此字符起始列地址只能为0~122
             unsigned char Page    页范围0～7
             unsigned char Dat  显示的字符
 输出参数  : NONE
 返 回 值  : NONE
*****************************************************************************/
void WriteChar_6x8(unsigned char Page,unsigned char Column, unsigned char Dat)
{
    unsigned char i, temp;     
       
    temp = Dat - 32;	 //ASCII码表的0~31为不可见字符，F6x8的编码首行为ASCii码表的第32行，故需减32
    if(Column > 122)
    {
        Column = 0;		 //若无法写下一个字符，则另起一页，并将列地址改至首列
        Page++;
    }
    SetPos(Page, Column);
    for(i = 0; i < 6; i++)
    {     
        WriteDat(F6x8[temp][i]);  
    }
}

/*****************************************************************************
 函 数 名  : WriteStr_6x8
 功能描述  : 写入一组6x8标准ASCII字符串
 输入参数  : unsigned char Page      页范围0～7     
             unsigned char Column    显示的横坐标0~122  
             unsigned char Str[]     显示的字符串
 输出参数  : NONE
 返 回 值  : NONE
*****************************************************************************/
void WriteStr_6x8(unsigned char Page, unsigned char Column, unsigned char Str[])
{
    unsigned char j; 

    for (j=0; Str[j] != '\0'; j++)		//判断字符串是否结束，也可通过指针进行操作
    {    
        WriteChar_6x8(Page,Column,Str[j]);  	//在指定的地方写一个字符
        Column += 6;					//每写一个字符，列地址加6
    }
}

/*****************************************************************************
 函 数 名  : WriteStr_8x16
 功能描述  : 写入一组8x16标准ASCII字符串
 输入参数  : unsigned char Page     为页范围0～3,因为该格式的字符高度占用两页
 			 unsigned char Column   为显示的横坐标0~120
             unsigned char Str[]    要显示的字符串
 输出参数  : NONE
 返 回 值  : NONE
*****************************************************************************/
void WriteStr_8x16(unsigned char Page, unsigned char Column, unsigned char Str[])
{
    unsigned char i, j, temp;

    Page <<= 1;							//显示高度为16的字符时，屏幕0~7页转化为0~3行，即两页为一行
	                                    //也可不要此行，但需注意对应关系
    for (j=0;Str[j] != '\0'; j++)       //字符串未结束
    {    
        temp = Str[j] - 32;
        if(Column > 120)
        {
            Column = 0;
            Page += 2;					//若当前行写不下，则需一次换两页，方可继续写
        }

        SetPos(Page, Column);   
        for(i = 0; i < 8; i++) 
        {
            WriteDat(F8X16[temp][i]);   //先写一个字符的上半部分
        }
        
        SetPos(Page+1, Column);   
        for(i=8; i<16; i++) 
        {
            WriteDat(F8X16[temp][i]);
        }
        Column += 8;  
    }
}

/*****************************************************************************
 函 数 名  : WriteChinese16x16
 功能描述  : 写入一组16x16的中文字符串【需通过取模软件对需要的汉字进行编码】
 输入参数  : unsigned char Page       为页范围0～3
             unsigned char Column     为显示的横坐标0~114,  114 = 128-16(即必须保证写满一个字)
             unsigned char Str[]      要显示的中文字符串
 输出参数  : NONE
 返 回 值  : NONE
 备    注  ：请用户仔细体会该函数的写法
*****************************************************************************/
void WriteChinese16x16(unsigned char Page,unsigned char Column,unsigned char Str[])
{
    unsigned char i, j;
    unsigned int  Address; 
    
    Page <<= 1;                    //两页为一行，page取值为0~3
    for(j=0;Str[j]!='\0';)
    {
        i = 0;
        Address = 1;
        while(font16x16[i] > 127)  //ASCII码为7位二进制表示的，因此最大为127,若大于127,已说明其不是ASCII码了。
		                           //汉字表示需两个字节，为兼容ASCII码，计算机中用内码表示，两个字节最高位均为1，即大于127
        {
            if(font16x16[i] == Str[j])		   //若汉字数组中第i个汉字与实参第j个字的第一个字节相同
            {
                if(font16x16[i+1] == Str[j+1]) //且汉字数组中第i个汉字与实参第j个字的第二个字节也相同
                {
                    Address = i*16;			   //则实际第j个汉字就采用font16*16的第i个汉字的编码
                    break;
                }
            }
            i += 2;            				   //汉字索引前移一个,指向汉字数组中的下一个汉字
        }									   //汉字已定义为char型格式，即一个汉字占两个char型的宽度
        
        if(Column > 112)
        {
            Column = 0;
            Page  += 2;						   //每换一次行，增加两页
        }
        
        if(Address != 1)                       // 所明汉字的字符串非空，或表示实参的编码可以在汉字数组对应编码中找到                 
        {
            SetPos(Page, Column);			   //设置上半部分的起始位置
            for(i=0;i<16;i++)               
            {
                WriteDat(font16x16_code[Address]);  //写汉字上半部分  
                Address++;
            }
            SetPos(Page+1,Column);                  //设置下半部分的起始位置
            for(i=0;i<16;i++)          
            {
                WriteDat(font16x16_code[Address]);	//写汉字下半部分
                Address++;
            }
            j += 2;        						    //实参中的汉字后移一个
        }
        else                                        //若实参数组内容为空，或者实参与指定的汉字数组常量不存在相同汉字            
        {
            SetPos(Page,Column);				    //则将不存在编码的汉字用空白填充
            for(i=0;i<16;i++)
            {
                WriteDat(0);
            }
            SetPos(Page+1,Column);
            for(i=0;i<16;i++)
            {           
                WriteDat(0);   
            }
            j++;								    //可能汉字中存在一个空白或英文字符，跳过一个字节再重新匹配
        }
        
        Column += 16;                               //写完一个汉字，列增加16
    }
}

/*****************************************************************************
 函 数 名  : WriteMixStrXx16
 功能描述  : 输出16x16汉字和8x16字符混合字符串 （字符串表格中需含有此字）
 输入参数  : unsigned char Page       为页范围0～3
 			 unsigned char Column     为显示的横坐标0~114
             unsigned char Str[]      要显示的混合字符串
 输出参数  : NONE
 返 回 值  : NONE
*****************************************************************************/
void WriteMixStrXx16(unsigned char Page, unsigned char Column, unsigned char Str[])
{
    unsigned char TempStr[3];
    unsigned char i = 0;    

    while(Str[i] != '\0')			                  //字符串未结束
    {
        if(Str[i] > 127)			                  //若非ASCII码表中字符
        {
            TempStr[0] = Str[i];		              //将实参第一个字节和第二个字节分别暂存（可能刚好是一个汉字）
            TempStr[1] = Str[i+1];
            TempStr[2] = '\0';                        //暂存字符串结束字符
            WriteChinese16x16(Page, Column, TempStr);  //显示汉字
            Column += 16;							  //列加16
            i += 2;									  //字符索引加2，汉字索引加1（一个汉字两个字节）
        }
        else										  //即混合字符串当中出现英文字符
        {
            TempStr[0] = Str[i];    
            TempStr[1] = '\0';                        //将一个英文字符当做字符串
            WriteStr_8x16(Page, Column, TempStr);     //写TemStr
            Column += 8;							  //列增加8列
            i += 1;									  //字符串索引增加一个字节
        }
    }
} 

/*****************************************************************************
 函 数 名  : PrintChar
 功能描述  : 将一个Char型数转换成3位数进行显示
 输入参数  : unsigned char Page      范围为0～7
			 unsigned char Column	 范围为0～122
             char          Dat       需要转化显示的数值 -128~127
 输出参数  : NONE
 返 回 值  : NONE
*****************************************************************************/
void PrintChar(unsigned char Page, unsigned char Column, char Dat)
{
    unsigned int i, j, k, temp;

    if(Dat < 0)
    {
        WriteChar_6x8(Page, Column, '-');	  //若为负数，先显示其负号
        temp = (unsigned char)(-Dat);  		  //将负数转换为正数
    }
    else
    {
        WriteChar_6x8(Page, Column, '+');
        temp = (unsigned char)Dat;			  //不能直接用于显示，因为数值将等效为ACSii，显示将变成字符 
    }
    i = temp/100;							  //分离百位数
    j = temp/10%10;							  //分离十位数
    k = temp%10;							  //分离个位数
    
    WriteChar_6x8(Page, Column+ 6, i);	      //写百位数
    WriteChar_6x8(Page, Column+12, j);	      //写十位数
    WriteChar_6x8(Page, Column+18, k);        //写个位数
}

/*****************************************************************************
 函 数 名  : PrintShort
 功能描述  : 将一个Short型数转换成5位数进行显示
 输入参数  : unsigned char Page    范围为0～7
             unsigned char Column  范围为0~122
             int           Dat     需要转化显示的数值
 输出参数  : NONE
 返 回 值  : NONE
*****************************************************************************/
void PrintShort(unsigned char Page, unsigned char Column, int Dat)
{
    unsigned int i, j, k, l, m, temp;  
    if(Dat < 0)
    {
        WriteChar_6x8(Page,Column,'-');
        temp = (unsigned int)(-Dat);  
    }
    else
    {
        WriteChar_6x8(Page,Column,'+');
        temp = (unsigned int)Dat;
    }
    
    l = temp/10000;				                //分离万位
    m = temp/1000%10;			 				//分离千位
    i = temp/100%10;			 				//分离百位
    j = temp/10%10;				 				//分离十位
    k = temp%10;				 				//分离个位
    WriteChar_6x8(Page, Column+ 6, l);			//显示万位
    WriteChar_6x8(Page, Column+12, m);			//显示千位
    WriteChar_6x8(Page, Column+18, i);			//显示百位
    WriteChar_6x8(Page, Column+24, j);			//显示十位
    WriteChar_6x8(Page, Column+30, k);  		//显示个位

}

/*****************************************************************************
 函 数 名  : PrintImage
 功能描述  : 将图像显示出来
 输入参数  : unsigned char * ImageTable     二维图像数组的地址
             unsigned char   RowNum         二维图像的行数1~64
             unsigned char   ColumnNum      二维图像的列数1~128
 输出参数  : NONE
 返 回 值  : NONE
 备    注  ：对应图形的编码生成请使用软件Image2Lcd v3.2.
             输出数据类型   ： C语言数组（*.C）
			 扫描方式       ： 数据水平，字节垂直（这样软件实现将很容易实现）
			 输出灰度       ： 单色（因为所选用的OLED为单色）
			 包含头像头数据 ： 不包含（包含用于摄像头所需的数字图像信息）
			 字节内数据反序 :  选择反序（即画√）
			 自右至左扫描   ： 不选择
			 自底至顶扫描   ： 不选择
			 高位在前       :  不选择
*****************************************************************************/
void PrintImage(unsigned char ImageTable[], unsigned char RowNum, unsigned char ColumnNum)
{
    unsigned char i,j,m,n;
	unsigned int num = 0;               //保存一幅图像包含的字节个数

	if(RowNum > 63)				 //越界判断
		RowNum = 63;
	if(ColumnNum > 127)
		ColumnNum = 127;

	m = RowNum/8;	    //行数对8取整
	n = RowNum%8;		//行数对8取余
	if(n)				//若余数不为0，即将行数按8（字节）进行分组，有余数
		m = m + 1 ;	//则将不能构成一个字节的行数补齐为一个字节

	for(i=0;i<m;i++)
	{	
		SetPos(i,0);
		for(j=0;j<ColumnNum;j++)
		{	
			WriteDat(ImageTable[num]);
			num++;
		}
	}
}

//========== 显示效果处理相关函数  ===============
/*****************************************************************************
 函 数 名  : ConHorScroll
 功能描述  : 连续水平滚屏
 输入参数  : unsigned char StartPage       滚屏起始地址
             unsigned char EndPage         滚屏终止地址
             bit Direction                 滚屏方向（0：右；1：左）
			 unsigned char speed		   滚屏速度（取值0~7）
 输出参数  : NONE
 返 回 值  : NONE
*****************************************************************************/
void ConHorScroll(unsigned char StartPage,unsigned char EndPage,bit Direction,unsigned char speed)
{
	WriteCmd(0x2e);          //若有移屏操作，先停止，以避免破坏RAM内容
	
	if(Direction)  
		WriteCmd(0x27);		 //左移（实际为先停止左移）
	else
		WriteCmd(0x26); 	 //右移（实际为先停止右移）

	WriteCmd(0x00);
	WriteCmd(StartPage);     //活动区域起始页
	WriteCmd(speed);         //设置滚屏速度  0：5帧；1：64帧；2：128帧；3：256帧；4：3帧；5：4帧；6：25帧；7：2帧
	WriteCmd(EndPage);       //活动区域终止页
	WriteCmd(0x00);
	WriteCmd(0xff);
	WriteCmd(0x2f);			 //激活移屏

		
}

/*****************************************************************************
 函 数 名  : ConVerHorScroll
 功能描述  : 连续垂直水平滚屏（即斜角滚屏）
 输入参数  : unsigned char StartPage       滚屏起始地址
             unsigned char EndPage         滚屏终止地址
             bit Direction                 滚屏方向（0：右上角；1：左上角）
			 unsigned char speed		   滚屏速度	 （取值0~7）
			 unsigned char VerOffset       垂直偏移量（取值0~63）,为0时将没有垂直方向上移动，效果将等同于水平移动
 输出参数  : NONE
 返 回 值  : NONE
*****************************************************************************/
void ConVerHorScroll(unsigned char StartPage,unsigned char EndPage,bit Direction,unsigned char speed,unsigned char VerOffset)
{

	WriteCmd(0x2e);          //若有移屏操作，先停止，以避免破坏RAM内容
	if(Direction)  
		WriteCmd(0x2a);		 //向左上角移屏 
	else
		WriteCmd(0x29); 	 //向右上角移屏

	WriteCmd(0x00);
	WriteCmd(StartPage);     //活动区域起始页
	WriteCmd(speed);         //设置滚屏速度  0：5帧；1：64帧；2：128帧；3：256帧；4：3帧；5：4帧；6：25帧；7：2帧
	WriteCmd(EndPage);       //活动区域终止页
	WriteCmd(0x00);
	WriteCmd(VerOffset);	 //垂直方向偏移量，即值0~63
	WriteCmd(0x2f);			 //激活移屏
		
}

/*****************************************************************************
 函 数 名  : ConVerHorScroll
 功能描述  : 设置垂直滚屏的区域
 输入参数  : unsigned char FixRowNoe       固定区域首行
             unsigned char ScrollRowNo     固定区域尾行，滚屏行从固定区域尾行下一行开始
 输出参数  : NONE
 返 回 值  : NONE
*****************************************************************************/
void SetVerScrollArea(unsigned char FixRowNo,unsigned char ScrollRowNo)
{								  //配置说明：
								  //         1. FixRowNo = 0, ScrollRowNo = 64 ：整屏滚动
	WriteCmd(0xa3);               //         2. FixRowNo = 0, ScrollRowNo < 64 ：顶部区域滚动
	WriteCmd(FixRowNo);			  //         3. FixRowNo + ScrollRowNo < 64    ：中间屏滚动
	WriteCmd(ScrollRowNo);		  //         4. FixRowNo + ScrollRowNo = 64    ：底部区域滚动
}

//----------  显示数字0~9 6x8格式--------------------------------------
void PrintNum_6x8(unsigned char Page,unsigned char Column,unsigned char num)	  //num取值为0~9
{
	unsigned char i;

	if(Column > 122)
	{
		Page = Page + 1;
		Column = 0;
	}
	if(num<10)
	{
		SetPos(Page,Column);
		for(i=0;i<6;i++)
		{
			WriteDat(F6x8[num+16][i]);			//数字在ascii码表中从48开始,F6*8的第16行开始
		}
	}
	if((num>9)&&(num<16))
	{
		SetPos(Page,Column);
		for(i=0;i<6;i++)
		{
			WriteDat(F6x8[num+23][i]);			//数字在ascii码表中从48开始，F6*8的第33行开始，但10对应A，再减掉10为23
		}	
	}

}

//----------  显示数字0~9 8x16格式--------------------------------------
void PrintNum_8x16(unsigned char Page,unsigned char Column,unsigned char num)	  //num取值为0~15
{
	unsigned char i;
	 Page <<= 1;	
	if(Column > 120)
	{
		Page = Page + 2;
		Column = 0;
	}
	if(num<10)
	{
		SetPos(Page,Column);					 //设置上半页显示显示的位置
		for(i=0;i<8;i++)						 //显示上半页内容
		{
			WriteDat(F8X16[num+16][i]);
		}
	
		SetPos(Page+1,Column);					 //设置下半页显示显示的位置
		for(i=8;i<16;i++)						 //显示下半页内容
		{
			WriteDat(F8X16[num+16][i]);
		}
	}
	if((num>9)&&(num<16))
	{
				SetPos(Page,Column);			//设置上半页显示显示的位置
		for(i=0;i<8;i++)						 //显示上半页内容
		{
			WriteDat(F8X16[num+23][i]);
		}
	
		SetPos(Page+1,Column);					 //设置下半页显示显示的位置
		for(i=8;i<16;i++)						 //显示下半页内容
		{
			WriteDat(F8X16[num+23][i]);
		}
	}

}